## components/sensors/Kconfig.projbuild
```kconfig
menu "Sensors configuration"
    config SENSORS_DHT22_MEASUREMENT_BULK_SIZE
        int "DHT22: Number of measurements in bulk"
        default 5
        help
            Average value of bulk measurements are reported to the cloud.

    config SENSORS_DHT22_MEASUREMENT_BULK_SLEEP
        int "DHT22: Sleep time (seconds) between bulk measurements"
        default 10
        help
            Time in seconds between measurements inside the bulk.

    config SENSORS_SDS011_WARM_UP
        int "SDS011: Warm up time (seconds)"
        default 30
        help
            Time in seconds before the first measurement of SDS011.

    config SENSORS_SDS011_MEASUREMENT_BULK_SIZE
        int "SDS011: Number of measurements in bulk"
        default 10
        help
            Average value of bulk measurements are reported to the cloud.

    config SENSORS_SDS011_MEASUREMENT_BULK_SLEEP
        int "SDS011: Sleep time (seconds) between bulk measurements"
        default 5
        help
            Time in seconds between measurements inside the bulk.
endmenu
```

## components/sync/Kconfig.projbuild
```kconfig
menu "Sync configuration"
    config SYNC_WIFI_SSID
        string "SYNC: WiFi SSID"
        default "VogonMothership"

    config SYNC_WIFI_PASSWORD
        string "SYNC: WiFi Password"
        default "DontPanic!42"

    config SYNC_MQTT_BROKER
        string "SYNC: MQTT broker"
        default "mqtt://192.168.0.1"
endmenu
```

## main/Kconfig.projbuild
```kconfig
menu "Vogon Configuration"
	config SENSORS_GENERAL_MEASUREMENT_INTERVAL
		int "Measurement interval"
		default 10

	config SENSORS_ENVIRONMENTAL_MEASUREMENT_BULK_SIZE
		int "ENVIRONMENTAL SENSOR: Measurement bulk size"
		default 10

	config SENSORS_ENVIRONMENTAL_MEASUREMENT_BULK_SLEEP
		int "ENVIRONMENTAL SENSOR: Measurement bulk sleep (seconds)"
		default 5

	config SENSORS_PARTICULATE_WARM_UP
		int "PARTICULATE SENSOR: Warm up period (seconds)"
		default 10

	config SENSORS_PARTICULATE_MEASUREMENT_BULK_SIZE
		int "PARTICULATE SENSOR: Measurement bulk size"
		default 5

	config SENSORS_PARTICULATE_MEASUREMENT_BULK_SLEEP
		int "PARTICULATE SENSOR: Measurement bulk sleep"
		default 10

	config SYNC_WIFI_PROTOCOL
		int "SYNC: WiFi security protocol (ESP-IDF auth mode constant)"
		default 0

	config SYNC_MQTT_BROKER_URL
		string "SYNC: MQTT broker URL"
		default "mqtt:localhost:1883"
endmenu
```
