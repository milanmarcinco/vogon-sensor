## sdkconfig.defaults
```kconfig
# Minimal Vogon Sensor Configuration
# ESP-IDF Project Configuration

CONFIG_ESPTOOLPY_FLASHSIZE_4MB=y
CONFIG_SPI_FLASH_SUPPORT_BOYA_CHIP=y
CONFIG_LIBC_NEWLIB_NANO_FORMAT=y
CONFIG_ESP_MAIN_TASK_STACK_SIZE=4096
```
